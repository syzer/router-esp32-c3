## advanced/button-interrupt/sdkconfig.defaults
```kconfig
CONFIG_ESP_MAIN_TASK_STACK_SIZE=20000
CONFIG_ESP_SYSTEM_EVENT_TASK_STACK_SIZE=4096

# TODO this does not seem to work (should enable log level DEBUG)
CONFIG_LOG_DEFAULT_LEVEL_INFO=n
CONFIG_LOG_DEFAULT_LEVEL=4
# CONFIG_LWIP_IP_FORWARD=y          # basic router
# CONFIG_LWIP_NAT=y                 # NAT core
# CONFIG_LWIP_NAPT=y                # NAPT helper
# CONFIG_LWIP_NAPT_MAX=256          # table size – tune to taste
# CONFIG_LWIP_IP_REASSEMBLY=y       # required for NAPT

CONFIG_LWIP_IP_FORWARD=y
CONFIG_LWIP_NAT=y
CONFIG_LWIP_NAPT=y
```
